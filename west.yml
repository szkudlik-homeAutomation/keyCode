## west.yml
```yaml
manifest:
  defaults:
    remote: szkudlik-homeAutomation

  remotes:
    - name: szkudlik-homeAutomation
      url-base: https://github.com/szkudlik-homeAutomation

  projects:
    - name: Common_code
      path: src/Common_code
      repo-path: Common_code.git
      import: 
        path-prefix: keyCode
      revision: dbadca33fcd1feb218340fd0bfc49fccc0aa2418

  self:
      path: keyCode
```
